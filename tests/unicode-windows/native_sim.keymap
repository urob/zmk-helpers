#include "../behavior_keymap.dtsi"

&kscan {
    events = <
        // &de_ae
        ZMK_MOCK_PRESS(0,0,10)
        ZMK_MOCK_RELEASE(0,0,10)
        // shift + &de_oe
        ZMK_MOCK_PRESS(1,1,10)
        ZMK_MOCK_PRESS(0,1,10)
        ZMK_MOCK_RELEASE(0,1,10)
        ZMK_MOCK_RELEASE(1,1,10)
    >;
};
